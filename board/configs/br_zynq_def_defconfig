## board/configs/br_zynq_def_defconfig
```kconfig
BR2_arm=y
BR2_cortex_a9=y
BR2_ARM_ENABLE_NEON=y
BR2_ARM_ENABLE_VFP=y
BR2_GLOBAL_PATCH_DIR="board/xilinx/patches"
BR2_DOWNLOAD_FORCE_CHECK_HASHES=y
# R2_ROOTFS_POST_BUILD_SCRIPT="board/zynq/post-build.sh"
# BR2_ROOTFS_POST_IMAGE_SCRIPT="board/zynq/post-image.sh"
# BR2_LINUX_KERNEL_DTS_SUPPORT=y
# BR2_LINUX_KERNEL_INTREE_DTS_NAME="xilinx/zynq-zc702"
BR2_PACKAGE_HOST_DOSFSTOOLS=y
BR2_PACKAGE_HOST_GENIMAGE=y
BR2_PACKAGE_HOST_MTOOLS=y

BR2_GCC_TARGET_FPU="neon"
BR2_ARM_CPU_HAS_NEON=y
BR2_ARM_CPU_MAYBE_HAS_NEON=y
BR2_ARM_FPU_NEON=y
BR2_PACKAGE_BAYER2RGB_NEON_ARCH_SUPPORTS=y
BR2_KERNEL_HEADERS_CUSTOM_GIT=y
BR2_KERNEL_HEADERS_CUSTOM_REPO_URL="file:///home/serg/Documents/Xilinx/ZynqBroot/linux-xlnx"
BR2_KERNEL_HEADERS_CUSTOM_REPO_VERSION="865e73109750d465f06dee019396406a354eb9d2"
BR2_PACKAGE_HOST_LINUX_HEADERS_CUSTOM_6_12=y

BR2_TOOLCHAIN=y
BR2_TOOLCHAIN_USES_GLIBC=y
BR2_TOOLCHAIN_BUILDROOT_GLIBC=y
BR2_TOOLCHAIN_BUILDROOT_LIBC="glibc"
BR2_PACKAGE_GLIBC_ARCH_SUPPORTS=y
BR2_PACKAGE_GLIBC_SUPPORTS=y
BR2_PACKAGE_GLIBC_UTILS=y


BR2_INSTALL_LIBSTDCPP=y
BR2_PACKAGE_LIBABSEIL_CPP_ARCH_SUPPORTS=y
BR2_GCC_ENABLE_OPENMP=y
BR2_TOOLCHAIN_HAS_OPENMP=y
BR2_GCC_VERSION_13_X=y
BR2_GCC_VERSION="13.4.0"
BR2_EXTRA_GCC_CONFIG_OPTIONS=""
BR2_TOOLCHAIN_BUILDROOT_CXX=y
BR2_PACKAGE_GCC_FINAL=y
BR2_PACKAGE_HOST_GDB_ARCH_SUPPORTS=y

#
# Kernel
#
BR2_LINUX_KERNEL=y
BR2_LINUX_KERNEL_CUSTOM_GIT=y
BR2_LINUX_KERNEL_CUSTOM_REPO_URL="file:///home/serg/Documents/Xilinx/ZynqBroot/linux-xlnx"
BR2_LINUX_KERNEL_CUSTOM_REPO_VERSION="865e73109750d465f06dee019396406a354eb9d2"
BR2_LINUX_KERNEL_VERSION="865e73109750d465f06dee019396406a354eb9d2"
BR2_LINUX_KERNEL_PATCH=""
BR2_LINUX_KERNEL_USE_DEFCONFIG=y
BR2_LINUX_KERNEL_DEFCONFIG="xilinx_zynq"
BR2_LINUX_KERNEL_CONFIG_FRAGMENT_FILES=""
BR2_LINUX_KERNEL_CUSTOM_LOGO_PATH=""
BR2_LINUX_KERNEL_UIMAGE=y
BR2_LINUX_KERNEL_GZIP=y
BR2_LINUX_KERNEL_UIMAGE_LOADADDR="0x8000"

#
# System configuration
#
BR2_JLEVEL=6
BR2_TARGET_GENERIC_HOSTNAME="Zynq_Mini"
BR2_TARGET_GENERIC_ISSUE="Welcome_Zynq"

#
# Filesystem images
#
BR2_TARGET_ROOTFS_CPIO=y
BR2_TARGET_ROOTFS_CPIO_FULL=y
BR2_TARGET_ROOTFS_CPIO_NONE=y
BR2_TARGET_ROOTFS_CPIO_UIMAGE=y
# BR2_TARGET_ROOTFS_EXT2 is not set
```

## boardext/Config.in
```kconfig
source "/home/serg/Documents/Xilinx/ZynqBroot/boardext/package/dglnt_dynclk/Config.in"
source "/home/serg/Documents/Xilinx/ZynqBroot/boardext/package/dglnt_hdmi/Config.in"
#source "/home/serg/Documents/Xilinx/ZynqBroot/boardext/package/ll/v_vtc/Config.in"
#source "/home/serg/Documents/Xilinx/ZynqBroot/boardext/package/v_common/Config.in"
source "/home/serg/Documents/Xilinx/ZynqBroot/boardext/package/xlnx_video/Config.in"
source "/home/serg/Documents/Xilinx/ZynqBroot/boardext/package/regwriter/Config.in"
```

## boardext/package/aoncv/Config.in
```kconfig
config BR2_AONCV
	bool "OpenCV test application"
	help
        Implement OpenCV app
```

## boardext/package/dglnt_dynclk/Config.in
```kconfig
config BR2_PACKAGE_DGLNT_DYNCLK
	bool "Digilent DYNCLK driver support"
	help
        Implement Digilent DYNCLK driver
```

## boardext/package/dglnt_hdmi/Config.in
```kconfig
config BR2_PACKAGE_DGLNT_HDMI
	bool "Digilent HDMI driver support"
	help
        Implement Digilent HDMI driver
```

## boardext/package/dglntdynclk/Config.in
```kconfig
config BR2_PACKAGE_DGLNTDYNCLK
	bool "Digilent DYNCLK driver support"
	help
        Implement Digilent DYNCLK driver
```

## boardext/package/dynclk/Config.in
```kconfig
config BR2_PACKAGE_DYNCLK
	bool "DYNCLK driver support"
	help
        Implement DynCLK driver
```

## boardext/package/regwriter/Config.in
```kconfig
config BR2_PACKAGE_REGWRITER
	bool "RegWriter driver support"
	help
        Implement RegWriter driver
```

## boardext/package/xlnx_video/Config.in
```kconfig
config BR2_PACKAGE_XLNX_VIDEO
	bool "XLNX_VIDEO application"
	help
        Implement XLNX_VIDEO app
```
